## boards/shields/biba40/Kconfig.defconfig
```kconfig
if SHIELD_BIBA40_LEFT

# Name must be less than 16 characters long!
config ZMK_KEYBOARD_NAME
    default "Biba40"

config ZMK_SPLIT_ROLE_CENTRAL
    default y

endif

if SHIELD_BIBA40_LEFT || SHIELD_BIBA40_RIGHT

config ZMK_SPLIT
    default y

endif

# Force-enable Mouse Emulation and HID Mouse Reports
CONFIG_ZMK_POINTING=y
CONFIG_ZMK_HID_REPORT_MOUSE=y
CONFIG_ZMK_MOUSE=y
CONFIG_ZMK_HID_REPORT_KEYBOARD=y
CONFIG_ZMK_HID_BOOT_PROTOCOL=y


if SHIELD_BIBA40_DONGLE

# Name must be less than 16 characters long!
config ZMK_KEYBOARD_NAME
    default "Biba40 Dongle"

config ZMK_SPLIT
    default y

config ZMK_SPLIT_ROLE_CENTRAL
    default y

# Two peripherals: left + right
config ZMK_SPLIT_BLE_CENTRAL_PERIPHERALS
    default 2

# 2 peripherals + 5 BT profiles = 7
config BT_MAX_CONN
    default 7

config BT_MAX_PAIRED
    default 7

endif
```
